## drivers/staging/uconsole/Kconfig
```kconfig
# SPDX-License-Identifier: GPL-2.0
config SIMPLE_AMPLIFIER_SWITCH
    tristate "Simple amplifier switch driver"
    depends on OF
    depends on GPIOLIB
    default n
    help
        Driver for simple gpio based switches. This can control a series of
        gpios with another one. Used to control amplifiers with headphone
        detect pin on uConsole.
```
