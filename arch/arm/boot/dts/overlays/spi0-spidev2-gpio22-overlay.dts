/dts-v1/;
/plugin/;

/ {
    compatible = "brcm,bcm2835";

    fragment@0 {
        target = <&spi0>;
        __overlay__ {
            #address-cells = <1>;
            #size-cells = <0>;

            spidev@2 {
                compatible = "spidev";
                reg = <2>;
                spi-max-frequency = <20000000>;
                status = "okay";
            };
        };
    };
};