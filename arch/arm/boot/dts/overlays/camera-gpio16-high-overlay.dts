/dts-v1/;
/plugin/;

/ {
    compatible = "brcm,bcm2835";

    fragment@0 {
        target = <&gpio>;
        __overlay__ {

            cam_high_pin: cam-high {
                gpio-hog;
                gpios = <16 0>;
                output-high;
                line-name = "cam-high-pin";
            };
        };
    };
};